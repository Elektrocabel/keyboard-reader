## prj.conf
```kconfig
CONFIG_SERIAL=y
CONFIG_UART_INTERRUPT_DRIVEN=y
CONFIG_GPIO=y

CONFIG_SPI=n
CONFIG_NFCT_PINS_AS_GPIOS=y
```

## app.overlay
```dts
/ {
    keyboard {
        compatible = "gpio-keys";
        keyboard0: keyboard_0 {
            gpios = <&gpio1 9 GPIO_ACTIVE_HIGH>,    //0
                    <&gpio0 25 GPIO_ACTIVE_HIGH>,   //1
                    <&gpio0 24 GPIO_ACTIVE_HIGH>,   //2
                    <&gpio0 31 GPIO_ACTIVE_HIGH>,   //3
                    <&gpio0 12 GPIO_ACTIVE_HIGH>,   //4
                    <&gpio0 11 GPIO_ACTIVE_HIGH>,   //5
                    <&gpio0 9 GPIO_ACTIVE_HIGH>,    //6 - had to cut off NFC to use these
                    <&gpio0 10 GPIO_ACTIVE_HIGH>,   //7 - ref. https://infocenter.nordicsemi.com/topic/ug_nrf52840_dk/UG/dk/hw_nfc_if.html#hw_nfc_if
                    <&gpio1 1 GPIO_ACTIVE_HIGH>,
                    <&gpio1 2 GPIO_ACTIVE_HIGH>,
                    <&gpio1 3 GPIO_ACTIVE_HIGH>,
                    <&gpio1 4 GPIO_ACTIVE_HIGH>,
                    <&gpio1 5 GPIO_ACTIVE_HIGH>,
                    <&gpio1 6 GPIO_ACTIVE_HIGH>,
                    <&gpio1 7 GPIO_ACTIVE_HIGH>,
                    <&gpio1 8 GPIO_ACTIVE_HIGH>,
                    <&gpio1 10 GPIO_ACTIVE_HIGH>,
                    <&gpio1 11 GPIO_ACTIVE_HIGH>,
                    <&gpio1 12 GPIO_ACTIVE_HIGH>,
                    <&gpio1 13 GPIO_ACTIVE_HIGH>,
                    <&gpio1 14 GPIO_ACTIVE_HIGH>,
                    <&gpio1 15 GPIO_ACTIVE_HIGH>,
                    <&gpio0 2 GPIO_ACTIVE_HIGH>,
                    <&gpio0 26 GPIO_ACTIVE_HIGH>,
                    <&gpio0 27 GPIO_ACTIVE_HIGH>,
                    <&gpio0 3 GPIO_ACTIVE_HIGH>,
                    <&gpio0 4 GPIO_ACTIVE_HIGH>,
                    <&gpio0 28 GPIO_ACTIVE_HIGH>,
                    <&gpio0 29 GPIO_ACTIVE_HIGH>,
                    <&gpio0 30 GPIO_ACTIVE_HIGH>;
        };
    };
};
```

## src/main.c
```c
/*
 * Copyright (c) 2022 Libre Solar Technologies GmbH
 *
 * SPDX-License-Identifier: Apache-2.0
 */

#include <zephyr/kernel.h>
#include <zephyr/device.h>
#include <zephyr/drivers/uart.h>
#include <zephyr/drivers/gpio.h>

#include <string.h>
#include <stdio.h>

#include "gpios.h"

/* change this to any other UART peripheral if desired */
#define UART_DEVICE_NODE DT_CHOSEN(zephyr_shell_uart)

#define MSG_SIZE 32

/* queue to store up to 10 messages (aligned to 4-byte boundary) */
K_MSGQ_DEFINE(uart_msgq, MSG_SIZE, 10, 4);

static const struct device *const uart_dev = DEVICE_DT_GET(UART_DEVICE_NODE);

/* receive buffer used in UART ISR callback */
static char rx_buf[MSG_SIZE];
static int rx_buf_pos;

/*
 * Read characters from UART until line end is detected. Afterwards push the
 * data to the message queue.
 */
void serial_cb(const struct device *dev, void *user_data)
{
	uint8_t c;

	if (!uart_irq_update(uart_dev)) {
		return;
	}

	if (!uart_irq_rx_ready(uart_dev)) {
		return;
	}

	/* read until FIFO empty */
	while (uart_fifo_read(uart_dev, &c, 1) == 1) {
		if ((c == '\n' || c == '\r') && rx_buf_pos > 0) {
			/* terminate string */
			rx_buf[rx_buf_pos] = '\0';

			/* if queue is full, message is silently dropped */
			k_msgq_put(&uart_msgq, &rx_buf, K_NO_WAIT);

			/* reset the buffer (it was copied to the msgq) */
			rx_buf_pos = 0;
		} else if (rx_buf_pos < (sizeof(rx_buf) - 1)) {
			rx_buf[rx_buf_pos++] = c;
		}
		/* else: characters beyond buffer size are dropped */
	}
}

/*
 * Print a null-terminated string character by character to the UART interface
 */
void print_uart(char *buf)
{
	int msg_len = strlen(buf);

	for (int i = 0; i < msg_len; i++) {
		uart_poll_out(uart_dev, buf[i]);
	}
}

static int current_driver = 0;

void gpio_init(void) {
	int ret = gpio_pin_configure_dt(&gpio[0], GPIO_OUTPUT_HIGH);
	if (ret < 0)
		print_uart("error :(\r\n");
	for (int i=1; i<PIN_NUM; i++) {
		ret = gpio_pin_configure_dt(&gpio[i], GPIO_INPUT | GPIO_PULL_DOWN);
		if (ret < 0)
			print_uart("error :(\r\n");
	}
}

void select_next(void) {
	int ret = gpio_pin_configure_dt(&gpio[current_driver], GPIO_INPUT | GPIO_PULL_DOWN);
	if (ret < 0)
		print_uart("error disabling :(\r\n");
	current_driver = (current_driver + 1) % PIN_NUM;
	ret = gpio_pin_configure_dt(&gpio[current_driver], GPIO_OUTPUT_HIGH);
	if (ret < 0)
		print_uart("error enabling next :(\r\n");
}

typedef struct {
	uint8_t first;
	uint8_t second;
} pair_t;

pair_t get_pair(void) {
	pair_t p = {0xff, 0xff};
	for (uint8_t i=0; i<PIN_NUM; i++) {
		for (uint8_t j=0; j<PIN_NUM; j++) {
			if (j == i)
				continue;
			int level = gpio_pin_get_dt(&gpio[j]);
			if (level < 0) {
				print_uart("an error getting pin state :(\r\n");
			} else if (level == 1) {
				if (p.first == 0xff) {
					p.first = i; p.second = j;
				} else if (p.first != j && p.second != i) {
					print_uart("detected more than one pair!\r\n");
				}
			}
		}
		select_next();
	}
	return p;
}

int main(void)
{
	char tx_buf[MSG_SIZE];

	if (!device_is_ready(uart_dev)) {
		printk("UART device not found!");
		return 0;
	}

	/* configure interrupt and callback to receive data */
	int ret = uart_irq_callback_user_data_set(uart_dev, serial_cb, NULL);

	if (ret < 0) {
		if (ret == -ENOTSUP) {
			printk("Interrupt-driven UART API support not enabled\n");
		} else if (ret == -ENOSYS) {
			printk("UART device does not support interrupt-driven API\n");
		} else {
			printk("Error setting UART callback: %d\n", ret);
		}
		return 0;
	}
	uart_irq_rx_enable(uart_dev);

	gpio_init();

	print_uart("Hello! I'm your keyboard bot.\r\n");
	print_uart("Type the name of a key, hold it and press enter to get a pin pair for it.\r\n");

	char s_to_print[20];
	/* indefinitely wait for input from the user */
	while (k_msgq_get(&uart_msgq, &tx_buf, K_FOREVER) == 0) {
		pair_t p = get_pair();
		sprintf(s_to_print, "%s: (%d, %d)\r\n", tx_buf, p.first, p.second);
		print_uart(s_to_print);
	}
	return 0;
}
```

## src/gpios.h
```c
#include <zephyr/drivers/gpio.h>
#ifndef GPIOS_H
#define GPIOS_H

#define PIN_NUM 30

static struct gpio_dt_spec gpio[30] = {
    GPIO_DT_SPEC_GET_BY_IDX(DT_NODELABEL(keyboard0), gpios, 0),
    GPIO_DT_SPEC_GET_BY_IDX(DT_NODELABEL(keyboard0), gpios, 1),
    GPIO_DT_SPEC_GET_BY_IDX(DT_NODELABEL(keyboard0), gpios, 2),
    GPIO_DT_SPEC_GET_BY_IDX(DT_NODELABEL(keyboard0), gpios, 3),
    GPIO_DT_SPEC_GET_BY_IDX(DT_NODELABEL(keyboard0), gpios, 4),
    GPIO_DT_SPEC_GET_BY_IDX(DT_NODELABEL(keyboard0), gpios, 5),
    GPIO_DT_SPEC_GET_BY_IDX(DT_NODELABEL(keyboard0), gpios, 6),
    GPIO_DT_SPEC_GET_BY_IDX(DT_NODELABEL(keyboard0), gpios, 7),
    GPIO_DT_SPEC_GET_BY_IDX(DT_NODELABEL(keyboard0), gpios, 8),
    GPIO_DT_SPEC_GET_BY_IDX(DT_NODELABEL(keyboard0), gpios, 9),
    GPIO_DT_SPEC_GET_BY_IDX(DT_NODELABEL(keyboard0), gpios, 10),
    GPIO_DT_SPEC_GET_BY_IDX(DT_NODELABEL(keyboard0), gpios, 11),
    GPIO_DT_SPEC_GET_BY_IDX(DT_NODELABEL(keyboard0), gpios, 12),
    GPIO_DT_SPEC_GET_BY_IDX(DT_NODELABEL(keyboard0), gpios, 13),
    GPIO_DT_SPEC_GET_BY_IDX(DT_NODELABEL(keyboard0), gpios, 14),
    GPIO_DT_SPEC_GET_BY_IDX(DT_NODELABEL(keyboard0), gpios, 15),
    GPIO_DT_SPEC_GET_BY_IDX(DT_NODELABEL(keyboard0), gpios, 16),
    GPIO_DT_SPEC_GET_BY_IDX(DT_NODELABEL(keyboard0), gpios, 17),
    GPIO_DT_SPEC_GET_BY_IDX(DT_NODELABEL(keyboard0), gpios, 18),
    GPIO_DT_SPEC_GET_BY_IDX(DT_NODELABEL(keyboard0), gpios, 19),
    GPIO_DT_SPEC_GET_BY_IDX(DT_NODELABEL(keyboard0), gpios, 20),
    GPIO_DT_SPEC_GET_BY_IDX(DT_NODELABEL(keyboard0), gpios, 21),
    GPIO_DT_SPEC_GET_BY_IDX(DT_NODELABEL(keyboard0), gpios, 22),
    GPIO_DT_SPEC_GET_BY_IDX(DT_NODELABEL(keyboard0), gpios, 23),
    GPIO_DT_SPEC_GET_BY_IDX(DT_NODELABEL(keyboard0), gpios, 24),
    GPIO_DT_SPEC_GET_BY_IDX(DT_NODELABEL(keyboard0), gpios, 25),
    GPIO_DT_SPEC_GET_BY_IDX(DT_NODELABEL(keyboard0), gpios, 26),
    GPIO_DT_SPEC_GET_BY_IDX(DT_NODELABEL(keyboard0), gpios, 27),
    GPIO_DT_SPEC_GET_BY_IDX(DT_NODELABEL(keyboard0), gpios, 28),
    GPIO_DT_SPEC_GET_BY_IDX(DT_NODELABEL(keyboard0), gpios, 29)
};

#endif //GPIOS_H
```
